## config/west.yml
```yaml
manifest:
  defaults:
      remote: urob
      revision: v0.3 # Pin everything to v0.3
  remotes:
    - name: zmkfirmware
      url-base: https://github.com/zmkfirmware
    - name: urob
      url-base: https://github.com/urob
    - name: badjeff
      url-base: https://github.com/badjeff
    - name: caksoylar
      url-base: https://github.com/caksoylar
  projects:
    - name: zmk
      remote: zmkfirmware
      revision: main
      import: app/west.yml
    - name: zmk-adaptive-key
      path: modules/zmk/adaptive-key
    - name: zmk-leader-key
      path: modules/zmk/leader-key
    - name: zmk-behavior-battery-percentage-printer
      remote: badjeff
      revision: main
    - name: zmk-rgbled-widget
      remote: caksoylar
      revision: main
  self:
    path: config
```
